## yocto/meta-mqtt-cmd/conf/layer.conf
```bitbake
# yocto/meta-mqtt-cmd/conf/layer.conf
BBPATH := "${BBPATH}:${LAYERDIR}"
BBFILES += "${LAYERDIR}/recipes-*/*/*.bb"

LAYERSERIES_COMPAT_meta-mqtt-cmd = "dunfell kirkstone scarthgap"
```
